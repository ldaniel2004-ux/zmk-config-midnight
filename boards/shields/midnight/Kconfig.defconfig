## boards/shields/midnight/Kconfig.defconfig
```kconfig
if SHIELD_MIDNIGHT_LEFT

config ZMK_KEYBOARD_NAME
    default "Midnight"

config ZMK_SPLIT_ROLE_CENTRAL
    default y

endif # SHIELD_MIDNIGHT_LEFT

if SHIELD_MIDNIGHT_LEFT || SHIELD_MIDNIGHT_RIGHT

config ZMK_SPLIT
    default y

endif # SHIELD_MIDNIGHT_LEFT || SHIELD_MIDNIGHT_RIGHT
```

## boards/shields/midnight/Kconfig.shield
```kconfig
config SHIELD_MIDNIGHT_LEFT
    def_bool $(shields_list_contains,midnight_left)

config SHIELD_MIDNIGHT_RIGHT
    def_bool $(shields_list_contains,midnight_right)
```
