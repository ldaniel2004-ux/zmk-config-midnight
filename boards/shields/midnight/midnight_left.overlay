#include "midnight.dtsi"

/ {
    chosen {
        zmk,matrix-transform = &default_transform;
    };
};

&kscan {
    col-gpios
        = <&gpio0 24 (GPIO_ACTIVE_LOW | GPIO_PULL_UP)>
        , <&gpio1  0 (GPIO_ACTIVE_LOW | GPIO_PULL_UP)>
        , <&gpio0 11 (GPIO_ACTIVE_LOW | GPIO_PULL_UP)>
        , <&gpio1  4 (GPIO_ACTIVE_LOW | GPIO_PULL_UP)>
        , <&gpio1  6 (GPIO_ACTIVE_LOW | GPIO_PULL_UP)>
        , <&gpio0 22 (GPIO_ACTIVE_LOW | GPIO_PULL_UP)>
        , <&gpio0 20 (GPIO_ACTIVE_LOW | GPIO_PULL_UP)>
        ;
};